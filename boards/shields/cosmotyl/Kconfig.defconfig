## boards/shields/cosmotyl/Kconfig.defconfig
```kconfig
if SHIELD_COSMOTYL_LEFT

config ZMK_KEYBOARD_NAME
    default "cosmotyl"

config ZMK_SPLIT_ROLE_CENTRAL
    default y

endif # SHIELD_COSMOTYL_LEFT

if SHIELD_COSMOTYL_LEFT || SHIELD_COSMOTYL_RIGHT

config ZMK_SPLIT
    default y

endif # SHIELD_COSMOTYL_LEFT || SHIELD_COSMOTYL_RIGHT
```
